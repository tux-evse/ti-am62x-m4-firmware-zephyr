## build/Kconfig/arch/Kconfig
```kconfig
# Load Zephyr Arch Kconfig descriptions.
osource "/home/a-fleloir/zephyrproject/zephyr/arch/x86/Kconfig"
osource "/home/a-fleloir/zephyrproject/zephyr/arch/xtensa/Kconfig"
osource "/home/a-fleloir/zephyrproject/zephyr/arch/sparc/Kconfig"
osource "/home/a-fleloir/zephyrproject/zephyr/arch/riscv/Kconfig"
osource "/home/a-fleloir/zephyrproject/zephyr/arch/posix/Kconfig"
osource "/home/a-fleloir/zephyrproject/zephyr/arch/nios2/Kconfig"
osource "/home/a-fleloir/zephyrproject/zephyr/arch/mips/Kconfig"
osource "/home/a-fleloir/zephyrproject/zephyr/arch/arm64/Kconfig"
osource "/home/a-fleloir/zephyrproject/zephyr/arch/arm/Kconfig"
osource "/home/a-fleloir/zephyrproject/zephyr/arch/arc/Kconfig"
```

## build/Kconfig/boards/Kconfig.defconfig
```kconfig
# Load Zephyr board defconfig descriptions.
osource "/home/a-fleloir/zephyrproject/zephyr/boards/phytec/phyboard_lyra/Kconfig.defconfig"
```

## build/Kconfig/boards/Kconfig.phyboard_lyra
```kconfig
# Load board Kconfig descriptions.
osource "/home/a-fleloir/zephyrproject/zephyr/boards/phytec/phyboard_lyra/Kconfig.phyboard_lyra"
```

## build/Kconfig/boards/Kconfig.sysbuild
```kconfig
# Load Sysbuild board Kconfig descriptions.
osource "/home/a-fleloir/zephyrproject/zephyr/boards/phytec/phyboard_lyra/Kconfig.sysbuild"
```
